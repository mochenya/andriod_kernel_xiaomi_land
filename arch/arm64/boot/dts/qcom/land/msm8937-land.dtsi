/*
 * Copyright (c) 2017, The Linux Foundation. All rights reserved.
 *
 * This program is free software; you can redistribute it and/or modify
 * it under the terms of the GNU General Public License version 2 and
 * only version 2 as published by the Free Software Foundation.
 *
 * This program is distributed in the hope that it will be useful,
 * but WITHOUT ANY WARRANTY; without even the implied warranty of
 * MERCHANTABILITY or FITNESS FOR A PARTICULAR PURPOSE.  See the
 * GNU General Public License for more details.
 */

#include "msm8937-audio-land.dtsi"
#include "msm8937-camera-land.dtsi"
#include "msm8937-camera-sensor-qrd-land.dtsi"
#include "msm8937-general-land.dtsi"
#include "msm8937-display-land.dtsi"
#include "msm8937-memory-land.dtsi"
#include "msm8937-pinctrl-land.dtsi"
#include "msm8937-regulator-land.dtsi"
